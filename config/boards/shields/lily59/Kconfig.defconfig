## config/boards/shields/lily59/Kconfig.defconfig
```kconfig
if SHIELD_LILY59_DONGLE || SHIELD_LILY59_LEFT || SHIELD_LILY59_RIGHT

config ZMK_BLE
	default y

config ZMK_USB
	default y

config ZMK_KEYBOARD_NAME
	default "Lily59"

endif

if SHIELD_LILY59_DONGLE

config ZMK_SPLIT
	default y

config ZMK_SPLIT_ROLE_CENTRAL
	default y

endif

if SHIELD_LILY59_DONGLE

config ZMK_SPLIT_BLE_CENTRAL_PERIPHERALS
	default 2

config BT_MAX_PAIRED
	default 7

config BT_MAX_CONN
	default 7

config ZMK_SPLIT_BLE_PREF_INT
	default 6

config ZMK_SPLIT_BLE_PREF_LATENCY
	default 399

config ZMK_SPLIT_BLE_PREF_TIMEOUT
	default 900

endif
```

## config/boards/shields/lily59/Kconfig.shield
```kconfig
# Copyright (c) 2020 Pete Johanson
# SPDX-License-Identifier: MIT

config SHIELD_LILY59_LEFT
    def_bool $(shields_list_contains,lily59_left)

config SHIELD_LILY59_RIGHT
    def_bool $(shields_list_contains,lily59_right)

config SHIELD_LILY59_DONGLE
    def_bool $(shields_list_contains,lily59_dongle)
```
